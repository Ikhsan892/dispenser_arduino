//Viral Science www.youtube.com/c/viralscience  www.viralsciencecreativity.com
//OLED 128x64 Graphics Display
//http://marlinfw.org/tools/u8glib/converter.html

#include <SPI.h>
#include <Wire.h>
#include <Adafruit_GFX.h>
#include <Adafruit_SSD1306.h>
#include "protothreads.h"

#define OLED_RESET 4
Adafruit_SSD1306 display(OLED_RESET);

pt ptTampilanUtama;  // Instance ProtoThread Tampilan Utama
pt ptFloat;
pt ptButtonFloat;
pt ptSuhu;

int ledMagnet = 13;
int ledFloat = 12;
int ledOverHeat = 11;

// Button Initial Indicator
int buttonFloatValue = 0;
int suhu = 0;

int sensorMagnet = 5; 
int sensorFloat = 4;
int sensorSuhu = A2;
int sensorFlow = 2;

// 'template oled', 128x32px
const unsigned char myBitmap [] PROGMEM = {
  0x00, 0x00, 0x00, 0x00, 0x00, 0x00, 0x00, 0x00, 0x00, 0x80, 0x00, 0x00, 0x00, 0x00, 0x00, 0x00, 
  0x00, 0x00, 0x00, 0x00, 0x00, 0x00, 0x0e, 0x00, 0x01, 0xc0, 0x00, 0x00, 0x00, 0x00, 0x00, 0x00, 
  0x00, 0x00, 0x00, 0x00, 0x00, 0x00, 0x1f, 0x00, 0x03, 0xe0, 0x00, 0x00, 0x00, 0x00, 0x00, 0x00, 
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  0x00, 0x00, 0x00, 0x00, 0x00, 0x00, 0x00, 0x00, 0x00, 0x00, 0x00, 0x00, 0x00, 0x00, 0x00, 0x00
};


// 'template oled 5', 128x32px
const unsigned char myBitmap5 [] PROGMEM = {
  0x00, 0x00, 0x00, 0x00, 0x00, 0x00, 0x00, 0x00, 0x00, 0x00, 0x00, 0x00, 0x00, 0x00, 0x00, 0x00, 
  0x00, 0x00, 0x00, 0x00, 0x00, 0x00, 0x00, 0x00, 0x00, 0x00, 0x00, 0x00, 0x00, 0x00, 0x00, 0x00, 
  0x00, 0x00, 0x00, 0x00, 0x00, 0x00, 0x00, 0x00, 0x00, 0x00, 0x00, 0x00, 0x00, 0x00, 0x00, 0x00, 
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  0x00, 0x00, 0x00, 0x00, 0x00, 0x00, 0x00, 0x00, 0x00, 0x00, 0x00, 0x00, 0x00, 0x00, 0x00, 0x00
};

// 'gelas percobaan', 64x25px
const unsigned char myBitmap6 [] PROGMEM = {
  0x00, 0x00, 0x1f, 0xff, 0xff, 0xfc, 0x00, 0x00, 0x00, 0x00, 0x1f, 0xff, 0xff, 0xfc, 0x00, 0x00, 
  0x00, 0x00, 0x1c, 0x00, 0x00, 0x1c, 0x00, 0x00, 0x00, 0x00, 0x1f, 0x80, 0x00, 0x1c, 0x00, 0x00, 
  0x00, 0x00, 0x1f, 0xfe, 0x00, 0x1c, 0x00, 0x00, 0x00, 0x00, 0x1f, 0xff, 0xf0, 0x7c, 0x00, 0x00, 
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  0x00, 0x00, 0x07, 0xff, 0xff, 0xf0, 0x00, 0x00
};



// 'template oled 2', 128x32px
const unsigned char myBitmap2 [] PROGMEM = {
  0x00, 0x00, 0x00, 0x00, 0x00, 0x00, 0x00, 0x00, 0x00, 0x00, 0x00, 0x00, 0x00, 0x00, 0x00, 0x00, 
  0x00, 0x00, 0x00, 0x00, 0x00, 0x00, 0x00, 0x00, 0x00, 0x00, 0x00, 0x00, 0x00, 0x00, 0x00, 0x00, 
  0x00, 0x00, 0x00, 0x00, 0x00, 0x00, 0x00, 0x00, 0x00, 0x00, 0x00, 0x00, 0x00, 0x00, 0x00, 0x00, 
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  0x00, 0x00, 0x00, 0x00, 0x00, 0x00, 0x00, 0x00, 0x00, 0x00, 0x00, 0x00, 0x00, 0x00, 0x00, 0x00
};



// 'baterai 1', 25x8px
const unsigned char baterai1 [] PROGMEM = {
  0xff, 0xff, 0xfe, 0x00, 0x80, 0x00, 0x02, 0x00, 0xbc, 0x00, 0x03, 0x80, 0xbc, 0x00, 0x03, 0x80, 
  0xbc, 0x00, 0x03, 0x80, 0xbc, 0x00, 0x03, 0x80, 0x80, 0x00, 0x02, 0x00, 0xff, 0xff, 0xfe, 0x00
};

// 'baterai 2', 25x8px
const unsigned char baterai2 [] PROGMEM = {
  0x00, 0x00, 0x00, 0x00, 0x00, 0x00, 0x00, 0x00, 0x01, 0xe0, 0x00, 0x00, 0x01, 0xe0, 0x00, 0x00, 
  0x01, 0xe0, 0x00, 0x00, 0x01, 0xe0, 0x00, 0x00, 0x00, 0x00, 0x00, 0x00, 0x00, 0x00, 0x00, 0x00
};
// 'baterai 3', 25x8px
const unsigned char baterai3 [] PROGMEM = {
  0x00, 0x00, 0x00, 0x00, 0x00, 0x00, 0x00, 0x00, 0x00, 0x0f, 0x00, 0x00, 0x00, 0x0f, 0x00, 0x00, 
  0x00, 0x0f, 0x00, 0x00, 0x00, 0x0f, 0x00, 0x00, 0x00, 0x00, 0x00, 0x00, 0x00, 0x00, 0x00, 0x00
};
// 'baterai 4', 25x8px
const unsigned char baterai4 [] PROGMEM = {
  0x00, 0x00, 0x00, 0x00, 0x00, 0x00, 0x00, 0x00, 0x00, 0x00, 0x78, 0x00, 0x00, 0x00, 0x78, 0x00, 
  0x00, 0x00, 0x78, 0x00, 0x00, 0x00, 0x78, 0x00, 0x00, 0x00, 0x00, 0x00, 0x00, 0x00, 0x00, 0x00
};



// 'template oled Jangan Di Coba', 13x5px
const unsigned char panah1 [] PROGMEM = {
  0xff, 0xf8, 0x3f, 0xe0, 0x1f, 0xc0, 0x07, 0x00, 0x02, 0x00
};


// 'template oled Jangan Di Coba', 13x5px
const unsigned char panah2 [] PROGMEM = {
  0xff, 0xf8, 0x3f, 0xe0, 0x1f, 0xc0, 0x07, 0x00, 0x02, 0x00
};

// 'Logo petir', 15x8px
const unsigned char listrik [] PROGMEM = {
  0x01, 0x80, 0x03, 0x80, 0x07, 0x00, 0x1f, 0xf0, 0x1f, 0xf0, 0x01, 0xc0, 0x03, 0x80, 0x03, 0x00
};

// 'Logo Tanda Seru', 15x13px
const unsigned char tandaSeru [] PROGMEM = {
  0x0f, 0xc0, 0x1f, 0xe0, 0x1f, 0xe0, 0x1f, 0xe0, 0x1f, 0xe0, 0x1f, 0xe0, 0x1f, 0xe0, 0x0f, 0xc0, 
  0x00, 0x00, 0x00, 0x00, 0x0f, 0xc0, 0x1f, 0xe0, 0x0f, 0xc0
};

// 'Logo Silang EROR', 15x8px
const unsigned char tandaSilang [] PROGMEM = {
  0xf8, 0x3e, 0x7e, 0xfc, 0x1f, 0xf0, 0x07, 0xc0, 0x07, 0xc0, 0x1f, 0xf0, 0x7e, 0xfc, 0xf8, 0x3e
};


void setup()   
{ 

  PT_INIT(&ptFloat);
  PT_INIT(&ptButtonFloat);
  PT_INIT(&ptTampilanUtama);
  PT_INIT(&ptSuhu);


  display.begin(SSD1306_SWITCHCAPVCC, 0x3C);  // initialize I2C addr to 0x3C ( for 128x64 Display )
  
  display.clearDisplay(); // clear the display before starting the program to avoid adafruit splashscreen ( *we can also skip it by modifing header file )
  // drawBitmap(x-axis position, y-axis position, bitmap data, bitmap width, bitmap height, color)
 

  //memulai komunikasi Serial
Serial.begin(9600);
//mendklarasikan pin 2 sebagai INPUT dengan PullUP Resistor
pinMode(sensorMagnet, INPUT_PULLUP);
pinMode(sensorFloat, INPUT_PULLUP);
pinMode(sensorSuhu, INPUT_PULLUP);
pinMode(sensorFlow, INPUT_PULLUP);
pinMode(ledMagnet, OUTPUT);
pinMode(ledFloat, OUTPUT);
pinMode(ledOverHeat, OUTPUT);


  pembukaan ();

   
}
void loop() 
{ 
  
  int magnet = digitalRead(sensorMagnet);
  int sensorFT = digitalRead(sensorFloat);
//  
  if (magnet==HIGH) //LOW adalah Keadaan Tombol Ditekan
{
//  Matiin Mesin Aer
  digitalWrite(ledFloat,LOW);

  digitalWrite(ledMagnet, HIGH);
  display.clearDisplay();
  display.setTextSize(1);             // The fontsize
  display.setTextColor(WHITE);        // Draw white text
  display.setCursor(7, 15);           // Start at top-left corner
  display.print("PINTU GALON TERBUKA");       //the text
  display.setCursor(7, 25);           // Start at top-left corner
  display.print("HARAP TUTUP KEMBALI");       //the text
  display.drawBitmap(53, 0, tandaSeru, 15, 13, WHITE);
  display.display();
}

else

{
  digitalWrite(ledMagnet, LOW);//LOW adalah Keadaan Tombol Ditekan
  PT_SCHEDULE(tampilanUtama(&ptTampilanUtama,suhu));
  PT_SCHEDULE(LEDFloat(&ptFloat, magnet));
  PT_SCHEDULE(bacaSensorSuhu(&ptSuhu));
}


int bacaSensorSuhu(struct pt* pt){
  PT_BEGIN(pt);
  while(1){
    suhu = analogRead(sensorSuhu);
    suhu = map(suhu,0,1024,0,100);
    PT_YIELD(pt);  
  }
  PT_END(pt);
}

int LEDFloat(struct pt* pt, int magnet){
  PT_BEGIN(pt);
  while(1){
    buttonFloatValue = digitalRead(sensorFloat);
      if(buttonFloatValue == 1){
        digitalWrite(ledFloat,LOW);
      }else{
        digitalWrite(ledFloat,HIGH);
      }  
    PT_YIELD(pt);
  }
  PT_END(pt);
}


void pembukaan () 
{
  
  display.clearDisplay();
  display.drawBitmap(0, 0, myBitmap, 128, 32, WHITE);
  display.display();
  digitalWrite (ledMagnet, HIGH);
  delay(2000);
  
  display.clearDisplay();
  display.drawBitmap(0, 0, myBitmap5, 128, 32, WHITE);
  display.display();
  digitalWrite (ledMagnet, LOW);
  delay (800);
  
  display.clearDisplay();
  display.drawBitmap(32, 3, myBitmap6, 64, 25, WHITE);
  display.display();
  digitalWrite (ledMagnet, HIGH);
  delay (800);
  
  display.clearDisplay();
  display.drawBitmap(0, 0, myBitmap2, 128, 32, WHITE);
  display.display();
  digitalWrite (ledMagnet, LOW);
  delay (800);
  
  
}

int tampilanUtama (struct pt* pt, int suhu)
{

  PT_BEGIN(pt);
  while(1){
    display.clearDisplay();
    display.drawBitmap(102, 0, baterai1, 25, 8, WHITE);
    display.drawBitmap(0, 0, listrik, 15, 8, WHITE);
  
    
    display.drawBitmap(0, 26, panah1, 13, 5, WHITE);//kiri
    display.drawBitmap(114, 26, panah2, 13, 5, WHITE);//kanan
    
    
    display.setTextSize(1);             // The fontsize
    display.setTextColor(WHITE);        // Draw white text
    display.setCursor(35, 12);           // Start at top-left corner
    display.print("TAP KARTU");       //the text
    if(suhu >= 50){
      display.setCursor(50, 0);           // Start at top-left corner
      display.print("E100");
    }else{
      display.setCursor(45, 0);           // Start at top-left corner
      display.print(suhu);
      display.print(" 'C");
    }       
    display.setCursor(35, 25);           // Start at top-left corner
    display.print("15.04.2021");       //the text 
    display.display();
    
    PT_SLEEP(pt,500);
  
  
    display.drawBitmap(102, 0, baterai2, 25, 8, WHITE);
    display.display();
    
    PT_SLEEP(pt,500);
  
    
    display.clearDisplay();
    display.drawBitmap(102, 0, baterai1, 25, 8, WHITE);
   
    display.drawBitmap(102, 0, baterai2, 25, 8, WHITE);
    display.drawBitmap(102, 0, baterai3, 25, 8, WHITE);
   
    display.drawBitmap(0, 0, listrik, 15, 8, WHITE);
    display.drawBitmap(0, 26, panah1, 13, 5, WHITE);//kiri
    display.drawBitmap(114, 26, panah2, 13, 5, WHITE);//kanan
   
    display.setTextSize(1);             // The fontsize
    display.setTextColor(WHITE);        // Draw white text
    display.setCursor(25, 12);           // Start at top-left corner
    display.print("SILAKAN MINUM");       //the text
    if(suhu >= 50){
      display.setCursor(50, 0);           // Start at top-left corner
      display.print("E100");
    }else{
      display.setCursor(45, 0);           // Start at top-left corner
      display.print(suhu);
      display.print(" 'C");
    }    
    display.setCursor(35, 25);           // Start at top-left corner
    display.print("15.04.2021");       //the text 
    display.display();
  
    PT_SLEEP(pt,500);
  
    
    display.drawBitmap(102, 0, baterai4, 25, 8, WHITE);
    display.display();
    
    PT_SLEEP(pt,500);
  }
  PT_END(pt);
  }
